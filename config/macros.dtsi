macro_tmux-right: macro_tmux-right{
compatible = "zmk,behavior-macro";
label = "macro_tmux-right";
#binding-cells = <0>;
bindings = <&kt LCTRL>, <&kp L>, <&kt LCTRL>;
};
macro_tmux-left: macro_tmux-left{
compatible = "zmk,behavior-macro";
label = "macro_tmux-left";
#binding-cells = <0>;
bindings = <&kt LCTRL>, <&kp H>, <&kt LCTRL>;
};
macro_tmux-up: macro_tmux-up{
compatible = "zmk,behavior-macro";
label = "macro_tmux-up";
#binding-cells = <0>;
bindings = <&kt LCTRL>, <&kp K>, <&kt LCTRL>;
};
macro_tmux-down: macro_tmux-down{
compatible = "zmk,behavior-macro";
label = "macro_tmux-down";
#binding-cells = <0>;
bindings = <&kt LCTRL>, <&kp J>, <&kt LCTRL>;
};